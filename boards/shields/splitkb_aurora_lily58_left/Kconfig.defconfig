## boards/shields/splitkb_aurora_lily58_left/Kconfig.defconfig
```kconfig
if SHIELD_SPLITKB_AURORA_LILY58_LEFT

config ZMK_KEYBOARD_NAME
    default "Aurora Lily58"

config ZMK_DISPLAY
    default y

endif # <--- Verifica che questo ci sia

if SHIELD_SPLITKB_AURORA_LILY58_RIGHT

config ZMK_KEYBOARD_NAME
    default "Aurora Lily58"

config ZMK_DISPLAY
    default y

endif # <--- E verifica che ci sia anche questo
```

## config/boards/shields/SHIELD_SPLITKB_AURORA_LILY58_LEFT/Kconfig.shield
```kconfig
# Copyright (c) 2022 The ZMK Contributors
# SPDX-License-Identifier: MIT

config SHIELD_SPLITKB_AURORA_LILY58_LEFT
    def_bool $(shields_list_contains,SPLITKB_AURORA_LILY58_left)

config SHIELD_SPLITKB_AURORA_LILY58_RIGHT
    def_bool $(shields_list_contains,SPLITKB_AURORA_LILY58_right)

# No whitespace after the comma or in the keyboard name!
#config SHIELD_SPLITKB_AURORA_LILY58_DONGLE
#    def_bool $(shields_list_contains,SPLITKB_AURORA_LILY58_dongle_prospector)

# No whitespace after the comma or in the keyboard name!
config SHIELD_SPLITKB_AURORA_LILY58_DONGLE
    def_bool $(shields_list_contains,SPLITKB_AURORA_LILY58_dongle)
```

## config/boards/shields/splitkb_aurora_lily58/Kconfig.defconfig
```kconfig
# Copyright (c) 2022 The ZMK Contributors
# SPDX-License-Identifier: MIT

# --- CONFIGURAZIONE LATO LEFT ---
if SHIELD_SPLITKB_AURORA_LILY58_LEFT

config ZMK_KEYBOARD_NAME
    default "Lily58"

# NOTA: Non impostiamo ZMK_SPLIT_ROLE_CENTRAL qui.
# Sarà il build.yaml a decidere se è 'y' (per BLE) o 'n' (per DONGLE).

endif

# --- CONFIGURAZIONE COMUNE SPLIT ---
if SHIELD_SPLITKB_AURORA_LILY58_LEFT || SHIELD_SPLITKB_AURORA_LILY58_RIGHT

config ZMK_SPLIT
    default y

endif

# --- CONFIGURAZIONE DONGLE (YADS o STANDARD) ---
if SHIELD_SPLITKB_AURORA_LILY58_DONGLE

config ZMK_KEYBOARD_NAME
    default "Lily58 Dongle"

config ZMK_SPLIT_ROLE_CENTRAL
    default y

config ZMK_SPLIT
    default y

# Configurazione specifica per gestire due metà come periferiche
config ZMK_SPLIT_BLE_CENTRAL_PERIPHERALS
    default 2 

# Supporto per più connessioni (2 metà + profili BT per PC/Tablet)
config BT_MAX_CONN
    default 6

config BT_MAX_PAIRED
    default 6

endif

# --- ABILITAZIONI MODULARI ---
# Queste configurazioni attivano ZMK Studio e la Shell se non diversamente specificato
config ZMK_STUDIO
    bool
    default y

config ZMK_SETTINGS_SHELL
    bool
    default y
```

## config/west.yml
```yaml
manifest:
  defaults:
    revision: v0.3.0
  remotes:
    - name: zmkfirmware
      url-base: https://github.com/zmkfirmware
    # - name: mctechnology17
    #   url-base: https://github.com/mctechnology17
    # - name: janpfischer
    #   url-base: https://github.com/janpfischer
    - name: janpfischer
      url-base: https://github.com/janpfischer
    # Additional modules containing boards/shields/custom code can be listed here as well
    # See https://docs.zephyrproject.org/3.2.0/develop/west/manifest.html#projects
  projects:
    - name: zmk
      remote: zmkfirmware
      import: app/west.yml
      # revision: main
    # support nice_oled and nice_epaper
    # - name: zmk-nice-oled
    #   remote: mctechnology17
    #   revision: main
    # - name: zmk-dongle-screen
    #   remote: janpfischer
    #   revision: main
    - name: prospector-zmk-module # <--- and these
      remote: carrefinho # <---
      revision: main
      # import: true
  self:
    path: config
```
