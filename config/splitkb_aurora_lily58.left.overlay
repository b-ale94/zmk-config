/ {
    /* Crea un alias per mappare i pin dello XIAO allo standard Pro Micro */
    chosen {
        zephyr,i2c = &i2c0;
    };
};

&i2c0 {
    status = "okay";
    label = "pro_micro_i2c"; // Forza il nome cercato dal modulo Prospector/Lily
};